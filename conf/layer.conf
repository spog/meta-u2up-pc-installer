## conf/layer.conf
```bitbake
# We have a conf and classes directory, add to BBPATH
BBPATH .= ":${LAYERDIR}"

# We have recipes-* directories, add to BBFILES
BBFILES += "${LAYERDIR}/recipes-*/*/*.bb \
            ${LAYERDIR}/recipes-*/*/*.bbappend"

BBFILE_COLLECTIONS += "installer"
BBFILE_PATTERN_installer = "^${LAYERDIR}/"
BBFILE_PRIORITY_installer = "6"

LAYERSERIES_COMPAT_installer = "thud"
```
